## sdkconfig.defaults
```kconfig
# BLE (Bluetooth Low Energy) configuration for ESP32-S3
# NOTE: ESP32-S3 does NOT support Classic Bluetooth (BR/EDR) or SPP
# Only BLE (Bluetooth Low Energy) is available on this chip

CONFIG_BT_ENABLED=y
CONFIG_BLUEDROID_ENABLED=y
CONFIG_BT_BLE_ENABLED=y

# USB configuration (handled by platformio.ini build flags)
# CONFIG_TINYUSB_HID_BUFSIZE=128
# CONFIG_ARDUINO_USB_MODE=1
# CONFIG_ARDUINO_USB_CDC_ON_BOOT=1
```
